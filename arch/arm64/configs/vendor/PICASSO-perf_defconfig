## arch/arm64/configs/vendor/PICASSO-perf_defconfig
```kconfig
###############################################################################################
#
# Reverse the order of the configs for the override to work properly
# Correct order is : 
#1.base_defconfig : kernel/msm-5.4/arch/arm64/configs/gki_defconfig 
#2.GKI.config : /kernel/msm-5.4/arch/arm64/configs/vendor/lahaina_GKI.config (GKI.config)
#3.QGKI.config : /kernel/msm-5.4/arch/arm64/configs/vendor/lahaina_QGKI.config  (QGKI.config)
#4.Consolidate.config : /kernel/msm-5.4/arch/arm64/configs/vendor/lahaina_consolidate.config
#5.debug.config : kernel/msm-5.4/arch/arm64/configs/vendor/lahaina_debug.config  (debug.config)
#6.asus_defconfig : kernel/msm-5.4/arch/arm64/configs/vendor/PICASSO_defconfig
#
###############################################################################################
CONFIG_LOCALVERSION="picasso-qgki-perf"
CONFIG_MACH_ASUS_PICASSO=y
CONFIG_TOUCHSCREEN_FTS_ASUS=m
CONFIG_SLA_STAIC_COLLECT=y
CONFIG_SLA=m
CONFIG_NETFILTER_XT_TARGET_LOG=y
CONFIG_NETFILTER_XT_MATCH_MULTIPORT=y
CONFIG_INPUT_SX932X=m
CONFIG_INPUT_SX932X_2ND=m
CONFIG_TSPDRV=n
CONFIG_INPUT_HALLSENSOR=m
CONFIG_INPUT_HALLSENSOR2=m
# ASUS_BSP : Support PD_RT1715 +++
CONFIG_RT_REGMAP=y
CONFIG_TCPC_CLASS=y
CONFIG_USB_POWER_DELIVERY=y
CONFIG_TCPC_RT1711H=y
# ASUS_BSP : Support PD_RT1715 ---
CONFIG_MSM_QBT_HANDLER=y
```

## arch/arm64/configs/vendor/SAKE_defconfig
```kconfig
###############################################################################################
#
# Reverse the order of the configs for the override to work properly
# Correct order is : 
#1.base_defconfig : kernel/msm-5.4/arch/arm64/configs/gki_defconfig 
#2.GKI.config : /kernel/msm-5.4/arch/arm64/configs/vendor/lahaina_GKI.config (GKI.config)
#3.QGKI.config : /kernel/msm-5.4/arch/arm64/configs/vendor/lahaina_QGKI.config  (QGKI.config)
#4.Consolidate.config : /kernel/msm-5.4/arch/arm64/configs/vendor/lahaina_consolidate.config
#5.debug.config : kernel/msm-5.4/arch/arm64/configs/vendor/lahaina_debug.config  (debug.config)
#6.asus_defconfig : kernel/msm-5.4/arch/arm64/configs/vendor/SAKE_defconfig
#
###############################################################################################
CONFIG_LOCALVERSION="-qgki-debug"
CONFIG_MACH_ASUS_SAKE=y
CONFIG_TOUCHSCREEN_FTS=m
GOODIX_FINGERPRINT_2ND=m
CONFIG_SLA_STAIC_COLLECT=y
CONFIG_SLA=m
CONFIG_NETFILTER_XT_TARGET_LOG=y
```

## arch/arm64/configs/vendor/VODKA-perf_defconfig
```kconfig
###############################################################################################
#
# Reverse the order of the configs for the override to work properly
# Correct order is : 
#1.base_defconfig : kernel/msm-5.4/arch/arm64/configs/gki_defconfig 
#2.GKI.config : /kernel/msm-5.4/arch/arm64/configs/vendor/lahaina_GKI.config (GKI.config)
#3.QGKI.config : /kernel/msm-5.4/arch/arm64/configs/vendor/lahaina_QGKI.config  (QGKI.config)
#4.Consolidate.config : /kernel/msm-5.4/arch/arm64/configs/vendor/lahaina_consolidate.config
#5.debug.config : kernel/msm-5.4/arch/arm64/configs/vendor/lahaina_debug.config  (debug.config)
#6.asus_defconfig : kernel/msm-5.4/arch/arm64/configs/vendor/VODKA_defconfig
#
###############################################################################################
CONFIG_LOCALVERSION="-qgki-perf"
CONFIG_MACH_ASUS_VODKA=y
CONFIG_TOUCHSCREEN_FTS=m
CONFIG_SLA_STAIC_COLLECT=y
CONFIG_SLA=m
CONFIG_NETFILTER_XT_TARGET_LOG=y
```

## arch/arm64/configs/vendor/ZS673KS-perf_defconfig
```kconfig
###############################################################################################
#
# Reverse the order of the configs for the override to work properly
# Correct order is : 
#1.base_defconfig : kernel/msm-5.4/arch/arm64/configs/gki_defconfig 
#2.GKI.config : /kernel/msm-5.4/arch/arm64/configs/vendor/lahaina_GKI.config (GKI.config)
#3.QGKI.config : /kernel/msm-5.4/arch/arm64/configs/vendor/lahaina_QGKI.config  (QGKI.config)
#4.Consolidate.config : /kernel/msm-5.4/arch/arm64/configs/vendor/lahaina_consolidate.config
#5.debug.config : kernel/msm-5.4/arch/arm64/configs/vendor/lahaina_debug.config  (debug.config)
#6.asus_defconfig : kernel/msm-5.4/arch/arm64/configs/vendor/ZS673KS_defconfig
#
###############################################################################################
CONFIG_LOCALVERSION="-qgki-perf"
CONFIG_MACH_ASUS_ZS673KS=y
CONFIG_TOUCHSCREEN_ROG=m
CONFIG_TOUCHSCREEN2_ROG=m
# CONFIG_TOUCHSCREEN_ST is not set
# CONFIG_TOUCHSCREEN_FTS is not set
CONFIG_NET_SCH_NETEM=y
CONFIG_SLA_STAIC_COLLECT=y
CONFIG_SLA=m
CONFIG_NETFILTER_XT_TARGET_LOG=y
CONFIG_NETFILTER_XT_MATCH_MULTIPORT=y
CONFIG_INPUT_SX932X=m
CONFIG_INPUT_SX932X_2ND=m
CONFIG_TSPDRV=y
CONFIG_INPUT_HALLSENSOR=m
CONFIG_INPUT_HALLSENSOR2=m
# ASUS_BSP : Support PD_RT1715 +++
CONFIG_RT_REGMAP=y
CONFIG_TCPC_CLASS=y
CONFIG_USB_POWER_DELIVERY=y
CONFIG_TCPC_RT1711H=y
CONFIG_USB_CONFIGFS_F_MTP=y
CONFIG_USB_CONFIGFS_F_PTP=y
# ASUS_BSP : Support PD_RT1715 ---
# ASUS BSP Fingerprint +++
CONFIG_GOODIX_FINGERPRINT=m
# CONFIG_MSM_QBT_HANDLER is not set
# ASUS BSP Fingerprint ---

##########################################
# user version config...
##########################################

CONFIG_CORESIGHT=y
CONFIG_CORESIGHT_LINKS_AND_SINKS=y
CONFIG_CORESIGHT_LINK_AND_SINK_TMC=y
CONFIG_CORESIGHT_SOURCE_ETM4X=y
CONFIG_CORESIGHT_DYNAMIC_REPLICATOR=y
CONFIG_CORESIGHT_STM=y
CONFIG_CORESIGHT_CTI=y
CONFIG_CORESIGHT_OST=y
CONFIG_CORESIGHT_TPDA=y
CONFIG_CORESIGHT_TPDM=y
CONFIG_CORESIGHT_HWEVENT=y
CONFIG_CORESIGHT_DUMMY=y
CONFIG_CORESIGHT_REMOTE_ETM=y
CONFIG_CORESIGHT_REMOTE_ETM_DEFAULT_ENABLE=0
CONFIG_CORESIGHT_CSR=y
CONFIG_CORESIGHT_TGU=y
CONFIG_CORESIGHT_EVENT=y
CONFIG_CORESIGHT_QGKI=y
CONFIG_CORESIGHT_CTI_SAVE_DISABLE=y
CONFIG_QCOM_QDSS_BRIDGE=y

CONFIG_USB_F_QDSS = y
CONFIG_USB_CONFIGFS_F_QDSS=y
CONFIG_DEBUG_ALIGN_RODATA=y
CONFIG_MSM_REMOTEQDSS=y

CONFIG_CMA_DEBUG=n
CONFIG_CMA_DEBUGFS=n
CONFIG_REGMAP_QTI_DEBUG=n
CONFIG_REGMAP_ALLOW_WRITE_DEBUGFS=n
CONFIG_MHI_DEBUG=n
CONFIG_CNSS2_DEBUG=n
CONFIG_SPMI_MSM_PMIC_ARB_DEBUG=n
CONFIG_SPMI_QTI_GLINK_DEBUG=y
CONFIG_REGULATOR_QTI_DEBUG=n
CONFIG_MSM_GPI_DMA_DEBUG=n
#CONFIG_COMMON_CLK_QCOM_DEBUG=n
CONFIG_MSM_DEBUGCC_LAHAINA=n
CONFIG_SM_DEBUGCC_SHIMA=n
CONFIG_IOMMU_TLBSYNC_DEBUG=n
CONFIG_IOMMU_DEBUG=n
CONFIG_QMP_DEBUGFS_CLIENT=n
CONFIG_QTI_PMIC_GLINK_CLIENT_DEBUG=n
CONFIG_QTI_BATTERY_GLINK_DEBUG=n
CONFIG_DYNAMIC_DEBUG=n
CONFIG_SERIAL_MSM_GENI_CONSOLE=n
CONFIG_DEBUG_CONSOLE_UNHASHED_POINTERS=n
CONFIG_DEBUG_INFO=n
CONFIG_DEBUG_PAGEALLOC=n
CONFIG_DEBUG_PANIC_ON_OOM=n
CONFIG_DEBUG_PAGEALLOC_ENABLE_DEFAULT=n
# CONFIG_DEBUG_PREEMPT is not set
CONFIG_DEBUG_SPINLOCK=n
CONFIG_QCOM_WDT_CORE=n



CONFIG_SLUB_DEBUG=n

CONFIG_TRACEPOINTS=n

CONFIG_SERIAL_EARLYCON=n

CONFIG_SERIAL_8250=n

CONFIG_SERIAL_8250_CONSOLE=n

CONFIG_SERIAL_8250_DMA=n

CONFIG_SERIAL_8250_PCI=n

CONFIG_SERIAL_8250_NR_UARTS=n

CONFIG_SERIAL_8250_RUNTIME_UARTS=n

CONFIG_SERIAL_8250_FSL=n

CONFIG_SERIAL_OF_PLATFORM=n

CONFIG_SERIAL_AMBA_PL011=n

CONFIG_SERIAL_AMBA_PL011_CONSOLE=n

CONFIG_SERIAL_SAMSUNG=n

CONFIG_SERIAL_SAMSUNG_UARTS_4=n

CONFIG_SERIAL_SAMSUNG_UARTS=n

CONFIG_SERIAL_SAMSUNG_CONSOLE=n

CONFIG_SERIAL_CORE_CONSOLE=n

#CONFIG_SERIAL_MSM_GENI=n

#CONFIG_SERIAL_MSM_GENI_HALF_SAMPLING=n

CONFIG_SERIAL_SPRD=n

CONFIG_SERIAL_SPRD_CONSOLE=n

CONFIG_SERIAL_MCTRL_GPIO=n

#CONFIG_SCHED_DEBUG=n

CONFIG_DEBUG_BUGVERBOSE=n

CONFIG_DEBUG_LIST=n



CONFIG_QCOM_RTB=y
CONFIG_QCOM_RTB_QGKI=y
CONFIG_QCOM_RTB_SEPARATE_CPUS=y


CONFIG_SLUB_DEBUG_PANIC_ON=n
CONFIG_IO_PGTABLE_PAGE_ACCOUNTING=n
CONFIG_SLUB_DEBUG_ON=n
CONFIG_DEBUG_KMEMLEAK=n
CONFIG_DEBUG_KMEMLEAK_EARLY_LOG_SIZE=4000
CONFIG_DEBUG_KMEMLEAK_DEFAULT_OFF=n
CONFIG_PAGE_POISONING=n
CONFIG_PAGE_POISONING_ENABLE_DEFAULT=n
CONFIG_DEBUG_STACK_USAGE=n
CONFIG_DEBUG_MEMORY_INIT=n
CONFIG_KPROBES=n
CONFIG_QTI_SYS_PM_VX=n
CONFIG_USB_ANNOUNCE_NEW_DEVICES=y
CONFIG_CGF_NOTIFY_EVENT=y
CONFIG_USB_HUB_USB3803=y
CONFIG_HH_DISABLE_UART=y
CONFIG_DEBUG_INFO=y
CONFIG_USB_EC_DRIVER=y
CONFIG_QTI_TZ_LOG=y
CONFIG_QCOM_EUD=n
CONFIG_ARCH_QCOM=y
ONFIG_ASUS_POWER_DEBUG=y
CONFIG_DEBUG_OBJECTS=y
CONFIG_DEBUG_OBJECTS_TIMERS=y
```

## arch/arm64/configs/vendor/ZS673KS_defconfig
```kconfig
###############################################################################################
#
# Reverse the order of the configs for the override to work properly
# Correct order is : 
#1.base_defconfig : kernel/msm-5.4/arch/arm64/configs/gki_defconfig 
#2.GKI.config : /kernel/msm-5.4/arch/arm64/configs/vendor/lahaina_GKI.config (GKI.config)
#3.QGKI.config : /kernel/msm-5.4/arch/arm64/configs/vendor/lahaina_QGKI.config  (QGKI.config)
#4.Consolidate.config : /kernel/msm-5.4/arch/arm64/configs/vendor/lahaina_consolidate.config
#5.debug.config : kernel/msm-5.4/arch/arm64/configs/vendor/lahaina_debug.config  (debug.config)
#6.asus_defconfig : kernel/msm-5.4/arch/arm64/configs/vendor/ZS673KS_defconfig
#
###############################################################################################
CONFIG_LOCALVERSION="-qgki-debug"
CONFIG_MACH_ASUS_ZS673KS=y
CONFIG_TOUCHSCREEN_ROG=m
CONFIG_TOUCHSCREEN2_ROG=m
# CONFIG_TOUCHSCREEN_ST is not set
# CONFIG_TOUCHSCREEN_FTS is not set
CONFIG_NET_SCH_NETEM=y
CONFIG_SLA_STAIC_COLLECT=y
CONFIG_SLA=m
CONFIG_NETFILTER_XT_TARGET_LOG=y
CONFIG_NETFILTER_XT_MATCH_MULTIPORT=y
CONFIG_INPUT_SX932X=m
CONFIG_INPUT_SX932X_2ND=m
CONFIG_TSPDRV=y
CONFIG_INPUT_HALLSENSOR=m
CONFIG_INPUT_HALLSENSOR2=m
# ASUS_BSP : Support PD_RT1715 +++
CONFIG_RT_REGMAP=y
CONFIG_TCPC_CLASS=y
CONFIG_USB_POWER_DELIVERY=y
CONFIG_TCPC_RT1711H=y
# ASUS_BSP : Support PD_RT1715 ---
# ASUS BSP Fingerprint +++
CONFIG_GOODIX_FINGERPRINT=m
# CONFIG_MSM_QBT_HANDLER is not set
# ASUS BSP Fingerprint ---
CONFIG_USB_ANNOUNCE_NEW_DEVICES=y
CONFIG_USB_VD_TEST=y
CONFIG_CGF_NOTIFY_EVENT=y
CONFIG_USB_HUB_USB3803=y
CONFIG_TUXERA_USERDEBUG=y
#CONFIG_EXFAT_FS=y
CONFIG_DEBUG_INFO=y
CONFIG_CPU_FREQ_STAT=y
CONFIG_USB_EC_DRIVER=y
CONFIG_USB_CONFIGFS_F_MTP=y
CONFIG_USB_CONFIGFS_F_PTP=y
CONFIG_QTI_TZ_LOG=y
CONFIG_QCOM_EUD=n
```

## drivers/aura_sync/Kconfig
```kconfig
config AURA_SYNC_INBOX
	tristate "aura_sync_inbox"
    default n
	help
		Enable aura_sync_inbox kernel module
		If unsure, say N.

config AURA_SYNC_STATION
	tristate "aura_sync_station"
    default n
	help
		Enable aura_sync_station kernel module
		If unsure, say N.

config AURA_SYNC_POGO
    tristate "aura_sync_station"
    default n
	help
		Enable aura_sync_station kernel module
		If unsure, say N.

config AURALIGHT_ENE8K41_PHONE
    tristate "ENE8K41 Phone AuraLight"
	depends on MACH_ASUS_ZS673KS
	default n
	help
		Enable ENE8K41 Phone AuraLight kernel module
		If unsure, say N.

config AURALIGHT_MS51_PHONE
    tristate "Nuvoton MS51 Phone AuraLight"
	depends on MACH_ASUS_ZS673KS || MACH_ASUS_PICASSO
	default m
	help
		Enable MS51 Phone AuraLight kernel module
		If unsure, say N.

config AURALIGHT_MS51_SIDE
    tristate "Nuvoton MS51 Phone Side AuraLight"
	depends on MACH_ASUS_ZS673KS
	default n
	help
		Enable MS51 Phone Side Light Bar AuraLight kernel module
		If unsure, say N.

config AURALIGHT_MS51_BACKCOVER
    tristate "Nuvoton MS51 Backcover AuraLight"
	depends on MACH_ASUS_ZS673KS
	default m
	help
		Enable MS51 BackCover AuraLight kernel module
		If unsure, say N.
```

## drivers/gamepad_hid_driver/Kconfig
```kconfig
config GAMEPAD_HID
	tristate "ASUS GamePad"
	bool "Asus Kuni Gamepad"
	default y
	depends on USB_HID
	help
		Enable GamePad driver
```

## drivers/input/fingerprint/Kconfig
```kconfig
config GOODIX_FINGERPRINT
	tristate "generic goodix fingerprint driver"
	depends on MACH_ASUS_ZS673KS
	default m
	help
	  add support for goodix fingerprint driver.
```

## drivers/input/fingerprint2nd/Kconfig
```kconfig
config GOODIX_FINGERPRINT_2ND
	tristate "generic goodix fingerprint driver"
	depends on MACH_ASUS_SAKE
	default m
	help
	   add support for goodix fingerprint driver.
```

## drivers/input/touchscreen/ROG5_TP/Kconfig
```kconfig
#
# Focaltech Touchscreen driver configuration
#

config TOUCHSCREEN_ROG
    tristate "Focaltech Touchscreen"
    depends on MACH_ASUS_ZS673KS || MACH_ASUS_PICASSO
    help
      Say Y here if you have Focaltech touch panel.
      If unsure, say N.
      
config TOUCHSCREEN_FTS_DIRECTORY
    string "Focaltech ts directory name"
    default "focaltech_touch_rog"
    depends on TOUCHSCREEN_ROG    
#endif
```

## drivers/input/touchscreen/ROG5_TP2/Kconfig
```kconfig
#
# Focaltech Touchscreen driver configuration
#
config TOUCHSCREEN2_ROG
    tristate "Focaltech Touchscreen"
    depends on MACH_ASUS_ZS673KS
    help
      Say Y here if you have Focaltech touch panel.
      If unsure, say N.
      
config TOUCHSCREEN_FTS_DIRECTORY
    string "Focaltech ts directory name"
    default "focaltech_touch_rog2"
    depends on TOUCHSCREEN2_ROG
#endif
```

## drivers/motor/tspdrv/Kconfig
```kconfig
menu "TouchSense driver support"

config TSPDRV
	tristate "TouchSense driver support"
	depends on MACH_ASUS_ZS673KS || MACH_ASUS_PICASSO
	default m

endmenu
```

## drivers/nfc/Kconfig
```kconfig
# SPDX-License-Identifier: GPL-2.0-only
#
# Near Field Communication (NFC) devices
#

menu "Near Field Communication (NFC) devices"
	depends on NFC

source "drivers/nfc/nfc/Kconfig"
source "drivers/nfc/ese/Kconfig"

endmenu

config NFC_QTI_I2C
	tristate "QTI NCI based NFC I2C Slave Driver for SNxxx"
	depends on I2C
	help
	  This enables the NFC driver for SNxxx based devices.
	  This is for I2C connected version. NCI protocol logic
	  resides in the usermode and it has no other NFC dependencies.

	  If unsure, say N.
```

## drivers/platform/asus/Kconfig
```kconfig
# Asus configuration options

config MACH_ASUS
	bool "Asus device"
	help
	  Support for Asus products

config MACH_ASUS_LAHAINA
	bool "Asus LAHAINA"
	depends on ARCH_LAHAINA
	select MACH_ASUS
	help
	  Support for LAHAINA Asus variants

menu "Asus board selection"

config MACH_ASUS_ZS673KS
	bool "ZS673KS board"
	select MACH_ASUS_KONA
	help
	  Support for Anakin (Rog5)

config MACH_ASUS_PICASSO
	bool "PICASSO board"
	select MACH_ASUS
	help
	  Support for Picasso

config MACH_ASUS_SAKE
	bool "SAKE board"
	select MACH_ASUS
	help
	  Support for Sake

config MACH_ASUS_VODKA
	bool "VODKA board"
	select MACH_ASUS
	help
	  Support for Vodka

endmenu
```

## drivers/power/qcom/Kconfig
```kconfig
config ASUS_POWER_DEBUG
        bool "ASUS POWER DEBUG"
        help
          This enables asus power debug feature
```

## drivers/sensors/Kconfig
```kconfig
# SPDX-License-Identifier: GPL-2.0-only
config SENSORS_SSC
	bool "Enable Sensors Driver Support for SSC"
	help
	  Add support for sensors SSC driver.
	  This driver is used for exercising sensors use case,
	  time syncing with ADSP clock.

config SENSORS_ICM206XX
	tristate "ICM206XX 6-axis gyroscope and acceleromater combo"
	depends on INPUT && SPI
	help
	  Say Y here if you want to support InvenSense ICM206XX
	  connected via an I2C bus.

	  To compile this driver as a module, choose M here: the
	  module will be called ICM206XX.
```

## drivers/tuxera/Kconfig
```kconfig
config TUXERA_USERDEBUG
	bool "Tuxera userdebug module for ASUS"
	depends on NLS_UTF8
	default n
	help
	  Say Y here if you want support Tuxera userdebug module
	  Say N here if you want support Tuxera user module
```
